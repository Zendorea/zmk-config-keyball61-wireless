/*
 * Copyright (c) 2020 ZMK Contributors
 *
 * SPDX-License-Identifier: MIT
 */

#include "keyball61.dtsi"

/*
 * Left/peripheral half = matrix only.
 * The nice!view display is supplied entirely by the `nice_view_adapter` +
 * `nice_view` shields (added in build.yaml): the adapter's nice_nano_v2 board
 * overlay defines the SPI0 bus (SCK P0.20, MOSI P0.17, MISO P0.25) with
 * cs-gpios = <&pro_micro 1> (D1/P0.06 bodge), and the nice_view shield defines
 * the ls0xx display node + zephyr,display chosen. Do NOT redeclare any of that
 * here or the `nice_view` label collides.
 */

&kscan0 {
	row-gpios
        = <&pro_micro 4 (GPIO_ACTIVE_HIGH | GPIO_PULL_DOWN)>
        , <&pro_micro 5 (GPIO_ACTIVE_HIGH | GPIO_PULL_DOWN)>
        , <&pro_micro 6 (GPIO_ACTIVE_HIGH | GPIO_PULL_DOWN)>
        , <&pro_micro 7 (GPIO_ACTIVE_HIGH | GPIO_PULL_DOWN)>
        , <&pro_micro 8 (GPIO_ACTIVE_HIGH | GPIO_PULL_DOWN)>
        ;
    col-gpios
        = <&pro_micro 21 GPIO_ACTIVE_HIGH>
        , <&pro_micro 20 GPIO_ACTIVE_HIGH>
        , <&pro_micro 19 GPIO_ACTIVE_HIGH>
	    , <&pro_micro 18 GPIO_ACTIVE_HIGH>
		, <&pro_micro 15 GPIO_ACTIVE_HIGH>
		, <&pro_micro 14 GPIO_ACTIVE_HIGH>
		, <&pro_micro 16 GPIO_ACTIVE_HIGH>
		;
};
